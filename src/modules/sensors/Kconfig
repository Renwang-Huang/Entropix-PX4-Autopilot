## src/modules/sensors/Kconfig
```kconfig
menuconfig MODULES_SENSORS
	bool "sensors"
	default n
	---help---
		Enable support for sensors

menuconfig USER_SENSORS
	bool "sensors running as userspace module"
	default n
	depends on BOARD_PROTECTED && MODULES_SENSORS
	---help---
		Put sensors in userspace memory

if MODULES_SENSORS

    # 支持陀螺仪传感器
    config SENSORS_VEHICLE_ANGULAR_VELOCITY
        bool "Include vehicle angular velocity"
        default y

    # 支持加速度计传感器
    config SENSORS_VEHICLE_ACCELERATION
        bool "Include vehicle acceleration"
        default y

    # 支持磁力计传感器
    config SENSORS_VEHICLE_MAGNETOMETER
        bool "Include vehicle magnetometer"
        default y

    # 支持光流传感器
    config SENSORS_VEHICLE_OPTICAL_FLOW
        bool "Include vehicle optical flow"
        default y

endif
```
